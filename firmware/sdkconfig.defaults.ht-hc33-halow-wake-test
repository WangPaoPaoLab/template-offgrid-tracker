## firmware/sdkconfig.defaults.ht-hc33-halow-wake-test
```kconfig
CONFIG_ESPTOOLPY_FLASHSIZE_16MB=y
CONFIG_PARTITION_TABLE_CUSTOM_FILENAME="partitions.csv"

CONFIG_OFFGRID_HT_HC33_HALOW_WAKE_TEST=y
CONFIG_OFFGRID_HT_HC33_HALOW_WAKE_TEST_BUTTON_GPIO=0
CONFIG_HALOW_COUNTRY_CODE="US"
CONFIG_HALOW_MESH_FREQUENCY_KHZ=914500
CONFIG_HALOW_MESH_BANDWIDTH_MHZ=1
CONFIG_MM_BCF_FILE="bcf_fgh100mhaamd.mbin"

CONFIG_HALOW_MESH_MODE=y
CONFIG_HALOW_MESH_AUTO_JOIN=n
CONFIG_HALOW_BLE_PROVISIONING=n
CONFIG_DAB_START_BATMAN=n
CONFIG_DAB_START_MQTT_RELAY=n
CONFIG_DAB_START_NETWORK_PACKET_RELAY=n
CONFIG_DAB_WIFI_EXTENDER=n
CONFIG_HALOW_PAWR_ENABLE=n
CONFIG_LOG_DEFAULT_LEVEL_INFO=y
```
